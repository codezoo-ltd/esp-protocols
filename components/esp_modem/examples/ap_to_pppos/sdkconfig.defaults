## components/esp_modem/examples/ap_to_pppos/sdkconfig.defaults
```kconfig
CONFIG_LWIP_PPP_SUPPORT=y
CONFIG_LWIP_PPP_PAP_SUPPORT=y
CONFIG_LWIP_TCPIP_TASK_STACK_SIZE=4096
CONFIG_LWIP_PPP_ENABLE_IPV6=n
CONFIG_UART_ISR_IN_IRAM=y
# Enable NAPT
CONFIG_LWIP_IP_FORWARD=y
CONFIG_LWIP_IPV4_NAPT=y
# Example Configuration
CONFIG_ESP_WIFI_SSID="nano_iot_gateway"
CONFIG_ESP_WIFI_PASSWORD="codezoo7"
CONFIG_ESP_WIFI_CHANNEL=1
CONFIG_ESP_MAX_STA_CONN=4
CONFIG_EXAMPLE_MODEM_PPP_APN="simplio.apn"
```

## components/esp_modem/examples/ssl/main/Kconfig.projbuild
```kconfig
menu "Example Configuration"

    config BROKER_URI
        string "Broker URL"
        default "mqtts://mqtt.eclipseprojects.io:8883"
        help
            URL of an mqtt broker which this example connects to.

    config BROKER_CERTIFICATE_OVERRIDE
        string "Broker certificate override"
        default ""
        help
            Please leave empty if broker certificate included from a textfile; otherwise fill in a base64 part of PEM
            format certificate

    config BROKER_CERTIFICATE_OVERRIDDEN
        bool
        default y if BROKER_CERTIFICATE_OVERRIDE != ""

    config BROKER_BIN_SIZE_TO_SEND
        # This option is not visible and is used only to set parameters for example tests
        # Here we configure the data size to send and to be expected in the python script
        int
        default 20000

    config EXAMPLE_MODEM_PPP_APN
        string "Set MODEM APN"
        default "internet"
        help
            Set APN (Access Point Name), a logical name to choose data network

    config EXAMPLE_MODEM_PPP_AUTH_USERNAME
        string "Set username for authentication"
        default "espressif"
        depends on !EXAMPLE_MODEM_PPP_AUTH_NONE
        help
            Set username for PPP Authentication.

    config EXAMPLE_MODEM_PPP_AUTH_PASSWORD
        string "Set password for authentication"
        default "esp32"
        depends on !EXAMPLE_MODEM_PPP_AUTH_NONE
        help
            Set password for PPP Authentication.

    config EXAMPLE_MODEM_PPP_AUTH_NONE
        bool "Skip PPP authentication"
        default n
        help
            Set to true for the PPP client to skip authentication

    config EXAMPLE_NEED_SIM_PIN
        bool "SIM PIN needed"
        default n
        help
            Enable to set SIM PIN before starting the example

    config EXAMPLE_SIM_PIN
        string "Set SIM PIN"
        default "1234"
        depends on EXAMPLE_NEED_SIM_PIN
        help
            Pin to unlock the SIM
			
endmenu
```
